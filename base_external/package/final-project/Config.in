## base_external/package/final-project/Config.in
```kconfig
config BR2_PACKAGE_FINAL_PROJECT
	bool "final-project"
	help
	  Includes executables for the AESD final project. It includes interfacing a distance and 
	  temperature & humidity sensor via I2C along with supporting client socket communication for 
	  BeagleBone Black.
```

## base_external/package/ldd/Config.in
```kconfig
config BR2_PACKAGE_LDD
	bool "ldd"
	help
	  Includes the misc_module and scull module
```
